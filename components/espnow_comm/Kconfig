## components/espnow_comm/Kconfig
```kconfig
menu "ESP-LEGO ESP-NOW Comm"

config ANNOUNCE_INTERVAL_MS
    int "Announce broadcast interval (ms)"
    default 1800
    range 500 30000
    help
        Interval between peer announcement broadcasts.
        Shorter = faster discovery, more airtime usage.

config ANNOUNCE_JITTER_MS
    int "Announce jitter (±ms)"
    default 200
    range 0 1000
    help
        Random jitter added to announce interval to prevent
        collision when multiple devices power on simultaneously.

config PEER_TIMEOUT_MS
    int "Peer timeout before OFFLINE (ms)"
    default 6000
    range 2000 60000
    help
        If no announce received from a peer within this time,
        its state transitions to OFFLINE.

config PEER_PENDING_TIMEOUT_MS
    int "PENDING_CHANGE fallback timeout (ms)"
    default 6500
    range 1000 30000
    help
        Time to wait in PENDING_CHANGE state before reverting
        to ACTIVE. Default 6500 = ANNOUNCE_INTERVAL × 2 + 500ms.

config MAX_PEERS
    int "Maximum tracked peers"
    default 20
    range 5 50
    help
        Maximum number of peer entries in the static peer table.
        20 × ~64 bytes ≈ 1.3KB RAM.

config READ_TIMEOUT_MS
    int "Sync request timeout (ms)"
    default 800
    range 50 2000
    help
        Timeout for a single synchronous read request.
        After timeout, request_read returns with value 0.

config COMM_CONCURRENT_CHECK
    bool "Block concurrent sync requests"
    default y
    help
        When enabled, only one sync request can be pending at a time.
        Concurrent requests are rejected with a log warning.
        V1.1 will add queueing.

config MAX_CAPABILITY_LEN
    int "Maximum capability descriptor length"
    default 128
    range 32 233
    help
        Max length of the capability descriptor string sent in MSG_ANNOUNCE.
        The descriptor describes the sensor's function, data format, etc.
        and is displayed in the web console + injected into LLM prompts.
        Max 233 bytes to fit within ESP-NOW 250-byte payload limit.

endmenu
```

## components/interpreter/Kconfig
```kconfig
menu "ESP-LEGO Interpreter"

config AST_POOL_SIZE
    int "AST node pool size"
    default 256
    range 64 4096
    help
        Number of AST nodes in the static pool.
        Each node is ~40 bytes. 256 × 40 = ~10KB RAM.

config LIST_POOL_SIZE
    int "List object pool size"
    default 8
    range 0 64
    help
        Number of list objects (each ~136 bytes).
        0 disables list support. 8 × 136 ≈ 1KB RAM.

config FUNC_POOL_SIZE
    int "User function pool size"
    default 16
    range 0 64
    help
        Number of user-defined function objects.
        0 disables user functions. 16 × ~20 = 320 bytes.

config MAX_BINDINGS
    int "Max bindings per scope"
    default 48
    range 16 128
    help
        Maximum variable/function bindings per environment scope.
        Built-in functions consume 27 slots.

config MAX_FUNC_PARAMS
    int "Max function parameters"
    default 8
    range 1 16
    help
        Maximum number of parameters per user-defined function.

config MAX_PARSE_DEPTH
    int "Max recursive parse depth"
    default 32
    range 16 256
    help
        Maximum nesting depth for recursive-descent parser.
        32 × 120B/stack-frame ≈ 4KB worst-case on 8KB task stack.

config MAX_EXEC_DEPTH
    int "Max recursive execution depth"
    default 64
    range 16 256
    help
        Maximum nesting depth for interpreter recursion
        (execute_block/eval/execute_while). Independent of parse_depth.

config MAX_LOOP_ITERATIONS
    int "Max total loop iterations"
    default 10000
    range 100 1000000
    help
        Total loop iterations across all nesting levels per script.
        Prevents runaway while loops.

config MAX_SENSOR_CALLS_PER_SCRIPT
    int "Max sensor calls per script"
    default 20
    range 5 200
    help
        Maximum number of remote_read() calls per script execution.
        Limits ESP-NOW channel usage.

config MAX_EXEC_STATEMENTS
    int "Max executed statements per script"
    default 50000
    range 1000 500000
    help
        Hard limit on total statements executed per script invocation.
        Catches pathological scripts not caught by other limits.

config SCRIPT_EXEC_TIMEOUT_MS
    int "Script execution watchdog timeout (ms)"
    default 30000
    range 1000 600000
    help
        FreeRTOS timer timeout for script execution watchdog.
        Timer is started before execution and stopped on completion.
        On expiry, s_script_timeout flag is set atomically.

config STRICT_MODE
    bool "Strict error handling"
    default y
    help
        When enabled: undefined variable access, type mismatches,
        and other runtime errors halt script execution.
        When disabled: errors produce warnings with default values.

config INTERN_TABLE_SIZE
    int "String intern table size"
    default 128
    range 32 512
    help
        Number of unique strings that can be interned.
        Each entry holds up to 64 bytes. 128 × 64 = 8KB .bss.

config ENV_POOL_SIZE
    int "Environment pool size (function nesting)"
    default 4
    range 1 16
    help
        Number of pre-allocated Environment objects for nested
        function call scopes. Each scope is ~528 bytes.
        4 × 528 ≈ 2KB RAM.

endmenu
```

## components/lcd_touch/Kconfig
```kconfig
menu "LCD and capacitive touch"

config LCD_TOUCH_SWAP_XY
    bool "Swap touch X and Y axes"
    default n

config LCD_TOUCH_INVERT_X
    bool "Invert touch X axis"
    default n

config LCD_TOUCH_INVERT_Y
    bool "Invert touch Y axis"
    default n

config LCD_TOUCH_RAW_MAX_X
    int "Maximum raw touch X coordinate"
    range 1 4095
    default 239

config LCD_TOUCH_RAW_MAX_Y
    int "Maximum raw touch Y coordinate"
    range 1 4095
    default 239

endmenu
```

## components/tcp_comm/Kconfig
```kconfig
menu "ESP-LEGO TCP Comm"

    config TCP_PORT
        int "TCP server port"
        default 8001
        range 1024 65535
        help
            Port for the binary TCP protocol between master and sensors.

    config TCP_BACKLOG
        int "TCP listen backlog"
        default 5
        range 1 20

    config TCP_SELECT_TIMEOUT_MS
        int "TCP select() timeout (ms)"
        default 1000
        range 100 10000

    config TCP_KEEPALIVE_IDLE_S
        int "TCP keepalive idle (seconds)"
        default 30
        range 5 300

    config TCP_KEEPALIVE_INTERVAL_S
        int "TCP keepalive probe interval (seconds)"
        default 5
        range 1 30

    config TCP_KEEPALIVE_COUNT
        int "TCP keepalive probe count"
        default 3
        range 1 10

    config TCP_RECONNECT_BASE_MS
        int "Reconnect base delay (ms)"
        default 1000
        range 500 10000

    config TCP_RECONNECT_MAX_MS
        int "Reconnect max delay (ms)"
        default 8000
        range 1000 60000

    config TCP_MAX_SENSORS
        int "Maximum concurrent sensor connections"
        default 20
        range 1 20

    config TCP_COMM_STACK_SIZE
        int "TCP comm task stack size"
        default 6144
        range 2048 16384

endmenu
```

## components/web_console/Kconfig
```kconfig
menu "ESP-LEGO Web Console"

    config WEB_CONSOLE_ENABLED
        bool "Enable web console (SoftAP + HTTP server + LLM client)"
        default y
        help
            When enabled, the master firmware creates a SoftAP hotspot
            "ESP-LEGO-Setup" on first boot (or BOOT button long-press)
            and serves a web configuration page at 192.168.4.1.

    config WEB_CONSOLE_TIMEOUT_SEC
        int "Auto-exit config mode after (seconds)"
        default 300
        range 0 3600
        help
            Inactivity timeout for the web console config mode.
            Set to 0 to disable auto-exit.

    config WIFI_SCAN_SHOW_5GHZ
        bool "Show 5GHz networks in scan results"
        default n
        help
            ESP32-S3 is 2.4 GHz only. Showing 5 GHz SSIDs is
            informational only (they cannot be connected).

    config BUTTON_PIN
        int "GPIO pin for entering config mode"
        default 0
        range 0 39
        help
            Long-press (3 s) on this pin triggers the ESP-LEGO-Setup
            SoftAP.  Default GPIO 0 is the BOOT button on most boards.

    config SOFTAP_CHANNEL
        int "SoftAP Wi-Fi channel"
        default 1
        range 1 11
        help
            Channel for the SoftAP hotspot.  Must match the channel
            your ESP-NOW network is configured for.

    config EXEC_LOG_BUF_SIZE
        int "Print output ring buffer size (bytes)"
        default 4096
        range 1024 16384
        help
            Circular buffer for capturing print() output from running
            scripts.  Visible via the web UI /api/exec_log endpoint.

    config HTTP_SERVER_STACK_SIZE
        int "HTTP server task stack size"
        default 6144
        range 4096 16384
        help
            Stack size for the esp_http_server task that handles
            web console requests.

endmenu
```

## main/Kconfig.projbuild
```kconfig
menu "ESP-LEGO Device Role"

choice DEVICE_ROLE
    prompt "Device role"
    default DEVICE_ROLE_MASTER
    help
        Select the firmware role for this ESP32-S3 board.
        Master: full script interpreter + ESP-NOW peer manager.
        Sensor: lite ESP-NOW slave (announce + command response).

config DEVICE_ROLE_MASTER
    bool "Master (interpreter + ESP-NOW manager)"

config DEVICE_ROLE_SENSOR
    bool "Sensor (ESP-NOW slave)"

endchoice

config SENSOR_MODULE_NAME
    string "Sensor module name"
    default "sensor"
    depends on DEVICE_ROLE_SENSOR
    help
        Human-readable name broadcast in announce packets.
        Master uses this to present module info in list_peers().
        Example: "kitchen_temp", "living_light", "garden_moisture"

choice SENSOR_ACQUISITION_PROFILE
    prompt "Sensor acquisition profile"
    default SENSOR_ACQUISITION_NONE
    depends on DEVICE_ROLE_SENSOR
    help
        Select the physical sensor read by this submodule.

config SENSOR_ACQUISITION_NONE
    bool "Generic ADC / no dedicated sensor"

config SENSOR_ACQUISITION_BH1750
    bool "BH1750 ambient light sensor (I2C)"

endchoice

config BH1750_SDA_GPIO
    int "BH1750 SDA GPIO"
    default 8
    range 0 48
    depends on SENSOR_ACQUISITION_BH1750

config BH1750_SCL_GPIO
    int "BH1750 SCL GPIO"
    default 9
    range 0 48
    depends on SENSOR_ACQUISITION_BH1750

choice SENSOR_ACTUATOR_PROFILE
    prompt "Actuator profile"
    default SENSOR_ACTUATOR_BUZZER
    depends on DEVICE_ROLE_SENSOR
    help
        Select at most one actuator driver for this submodule build.
        Sensor acquisition profiles remain unchanged.

config SENSOR_ACTUATOR_NONE
    bool "No actuator"

config SENSOR_ACTUATOR_BUZZER
    bool "Passive buzzer"

config SENSOR_ACTUATOR_SERVO
    bool "Hobby servo"

config SENSOR_ACTUATOR_PUMP
    bool "Timed water pump"

endchoice

config PUMP_GPIO
    int "Pump control GPIO"
    default 10
    range 0 48
    depends on SENSOR_ACTUATOR_PUMP

config PUMP_ACTIVE_HIGH
    bool "Pump output is active-high"
    default y
    depends on SENSOR_ACTUATOR_PUMP

config PUMP_MAX_RUN_MS
    int "Maximum pump run time per command (ms)"
    default 30000
    range 1 30000
    depends on SENSOR_ACTUATOR_PUMP

endmenu
```

## sdkconfig.defaults.pump
```kconfig
# ESP-LEGO timed pump submodule profile.
# Combine with sdkconfig.defaults and sdkconfig.defaults.sensor.
CONFIG_DEVICE_ROLE_SENSOR=y
# CONFIG_DEVICE_ROLE_MASTER is not set
CONFIG_IDF_TARGET="esp32c3"
# CONFIG_WEB_CONSOLE_ENABLED is not set
CONFIG_SENSOR_MODULE_NAME="pump"
CONFIG_SENSOR_ACTUATOR_PUMP=y
CONFIG_PUMP_GPIO=5
CONFIG_PUMP_ACTIVE_HIGH=y
CONFIG_PUMP_MAX_RUN_MS=30000
```
